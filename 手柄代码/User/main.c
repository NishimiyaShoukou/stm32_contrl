#include "system.h"
#include "SysTick.h"
#include "led.h"
#include "usart.h"
#include "iic.h"
#include "pwm.h"
#include "joy.h"
#include "oled.h"
#include "timer.h"
#include "Control_Task.h"
#include "spi.h"
#include "24l01.h"  
#define accur 0.015295//accur=18*3.3/4096（3.3/4096就是ADC采样精度，18是为了让波形转化一下能够显示在适当位子）

 //128*64  x:0~127 y:0~7

extern u8 flag;
extern u32 tick_ms;
int fre=1;
extern void Adc_Init(void);
extern void TIM1_PWM_Init(u16 arr,u16 psc);
extern void OLED_Init0(void);

void delay(u32 i)
{
	 while(i--);
}
u8 bmp1[] = {
0xFF,0xFF,0xFF,0xFF,0xFF,0xFF,0xFF,0xFF,0xFF,0xFF,0xFF,0xFF,0xFF,0xFF,0xFF,0xFF,
0xFF,0xFF,0xFF,0xFF,0xFF,0xFF,0xFF,0xFF,0xFF,0xFF,0xFF,0xFF,0xFF,0xFF,0xFF,0xFF,
0xFF,0xFF,0xFF,0xFF,0xFF,0xFF,0xFF,0xFF,0xFF,0xFF,0xFF,0xFF,0xFF,0xFF,0xFF,0xFF,
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0xFF,0xFF,0xFF,0xFF,0xFF,0xFF,0xFF,0xFF,0xFF,0xFF,0xFF,0xFF,0xFF,0xFF,0xFF,0xFF,/*"C:\Users\wangwentao\Pictures\oled.bmp",0*/
};

int main()
{
		u8 i=0;
		u8 key,mode;
	  u16 t=0;			 
	  u8 tmp_buf[33]; 
  	char lex[6];
		int x;
		SysTick_Init(72);
		NVIC_PriorityGroupConfig(NVIC_PriorityGroup_2);
	 
		led_Init();
//		USART1_Init(9600);
	
	  Joy_init();
		IIC_Init();
	//	OLED_Init0();
	  NRF24L01_Init();    	//初始化NRF24L01  
    
		OLED_Init();
	  NRF24L01_Check(); 
		OLED_DrawBMP(0,0,127,7,bmp1);
	  delay_ms(1000);
//	  delay_ms(1000);
		OLED_Clear();
//	  OLED_Init();
//	  delay_ms(200);
	 NRF24L01_TX_Mode();
		while(1)
		{
			 
				i++;
				if(i%20==0)
				{
//					led=~led;
					    i=0;
				}
				if(left_joy_l1==0||left_joy_y>=2.5)
				{
					
					 led=0;
				}
				else
				{
					  led=1;
				
			  }
				joy_get();
				OLED_ShowString(35,0,"stm32_joy",12);
				OLED_ShowString(0,2,"leftx:",12);
				OLED_Float(2,48,left_joy_x,3) ;
				OLED_ShowString(0,3,"lefty:",12);
				OLED_Float(3,48,left_joy_y,3) ;
				
				OLED_ShowString(0,4,"rightx:",12);
				OLED_Float(4,60,right_joy_x,3) ;
			  OLED_ShowString(0,5,"righty:",12);
				OLED_Float(5,60,right_joy_y,3) ;
				OLED_ShowString(0,6,"l1:",12);
			  OLED_ShowChar(36,6,(char)left_joy_l1+0x30,12);
				OLED_ShowString(80,6,"l2:",12);
				OLED_ShowChar(112,6,(char)left_joy_l2+0x30,12);
				OLED_ShowString(0,7,"r1:",12);
			  OLED_ShowChar(36,7,(char)right_joy_r1+0x30,12);
				OLED_ShowString(80,7,"r2:",12);
				OLED_ShowChar(112,7,(char)right_joy_r2+0x30,12);
				
			if(NRF24L01_TxPacket(tmp_buf)==TX_OK)
			{
				tmp_buf[0]='l';//加入结束符	
				tmp_buf[1]='x';//加入结束符	
				tmp_buf[2]=':';//加入结束符
        				
				tmp_buf[3]=(char)((int)left_joy_x)+0x30;
				tmp_buf[4]=(char)((int)left_joy_x*10%10)+0x30;
				tmp_buf[5]=(char)((int)left_joy_x*100%10)+0x30;
				tmp_buf[6]=(char)((int)left_joy_x*1000%10)+0x30;
				tmp_buf[7]=(char)((int)left_joy_y+0x30);
				tmp_buf[8]=(char)((int)left_joy_y*10%10)+0x30;
				tmp_buf[9]=(char)((int)left_joy_y*100%10)+0x30;
				tmp_buf[10]=(char)((int)left_joy_y*1000%10)+0x30;
				tmp_buf[11]='l';
				tmp_buf[12]=(char)left_joy_l1+0x30;
				tmp_buf[13]='l';
				tmp_buf[14]='2';
				tmp_buf[15]=(char)left_joy_l2+0x30;
				
				
				
				tmp_buf[16]='r';//加入结束符	
				tmp_buf[17]='x';//加入结束符	
				tmp_buf[18]=':';//加入结束符
        				
				tmp_buf[19]=(char)((int)right_joy_x)+0x30;
				tmp_buf[20]=(char)((int)right_joy_x*10%10)+0x30;
				tmp_buf[21]=(char)((int)right_joy_x*100%10)+0x30;
				tmp_buf[22]=(char)((int)right_joy_x*1000%10)+0x30;
				tmp_buf[23]=(char)((int)right_joy_y+0x30);
				tmp_buf[24]=(char)((int)right_joy_y*10%10)+0x30;
				tmp_buf[25]=(char)((int)right_joy_y*100%10)+0x30;
				tmp_buf[26]=(char)((int)right_joy_y*1000%10)+0x30;
				tmp_buf[27]='l';
				tmp_buf[28]=(char)right_joy_r1+0x30;
				tmp_buf[29]='l';
				tmp_buf[30]='2';
				tmp_buf[31]=(char)right_joy_r2+0x30;
				
				
				
				tmp_buf[32]=0;//加入结束符
      }	
       delay_ms(10);			
		}
	  
			
				
	  
		
}
